## Kconfig
```kconfig
# Copyright (c) 2026 Carl Henriksson
# SPDX-License-Identifier: MIT

rsource "drivers/sensor/ma730/Kconfig"
rsource "src/Kconfig"
```

## boards/polarityworks/rotr/Kconfig.defconfig
```kconfig
# Copyright (c) 2026 Carl Henriksson
# SPDX-License-Identifier: MIT

config ZMK_KEYBOARD_NAME
	default "ROTR" if BOARD_ROTR

if BOARD_ROTR
if USB
config USB_NRFX
	default y

config USB_DEVICE_STACK
	default y
endif

config BT_CTLR
	default BT
endif
```

## boards/polarityworks/rotr/Kconfig.rotr
```kconfig
# Copyright (c) 2026 Carl Henriksson
# SPDX-License-Identifier: MIT

config BOARD_ROTR
	select SOC_NRF52840_QIAA
	select ZMK_BOARD_COMPAT
	imply RETAINED_MEM
	imply RETENTION
	imply RETENTION_BOOT_MODE
```

## boards/polarityworks/rotr/board.yml
```yaml
# Copyright (c) 2026 Carl Henriksson
# SPDX-License-Identifier: MIT

board:
  name: rotr
  vendor: polarityworks
  socs:
    - name: nrf52840
      variants:
        - name: zmk
```

## boards/polarityworks/rotr/rotr_nrf52840_zmk_defconfig
```kconfig
# Copyright (c) 2026 Carl Henriksson
# SPDX-License-Identifier: MIT

CONFIG_ARM_MPU=y
CONFIG_GPIO=y

CONFIG_MA730_INPUT=y
CONFIG_MA730_INPUT_TRIGGER_GLOBAL_THREAD=y

CONFIG_ZMK_POINTING=y

# Adafruit nRF52 UF2 bootloader.
CONFIG_USE_DT_CODE_PARTITION=y
CONFIG_BUILD_OUTPUT_UF2=y
CONFIG_MPU_ALLOW_FLASH_WRITE=y

# Persistent ZMK settings.
CONFIG_NVS=y
CONFIG_SETTINGS_NVS=y
CONFIG_FLASH=y
CONFIG_FLASH_PAGE_LAYOUT=y
CONFIG_FLASH_MAP=y

CONFIG_ZMK_USB=y
CONFIG_ZMK_BLE=y

# Connection-aware power policy:
# - USB HID is preferred over BLE.
# - USB HID idle powers off after 15 minutes.
# - BLE/disconnected idle powers off after 5 minutes.
# - USB loss with no BLE, or BLE loss with no USB HID, powers off immediately.
CONFIG_ROTR_POWER_POLICY=y
CONFIG_ROTR_POWER_POLICY_USB_TIMEOUT_MS=900000
CONFIG_ROTR_POWER_POLICY_BLE_TIMEOUT_MS=300000

# WS2812 underglow.
# The LED strip is powered through the gpio1.11 ext-power rail. We keep the
# rail enabled and managed by src/rgb_indicator.c, and deliberately do NOT
# set CONFIG_ZMK_RGB_UNDERGLOW_EXT_POWER: coupling the rail to RGB on/off was
# the dead-underglow bug (ON_START never enabled the rail) and would also
# power-cycle the rail on every off-state flash. RGB on/off now only gates
# colour/animation; the rail stays powered.
CONFIG_ZMK_EXT_POWER=y
CONFIG_ZMK_RGB_UNDERGLOW=y
# Keep the toggled-on colour lit perpetually, including at idle. AUTO_OFF_IDLE
# would switch the LEDs off after the idle timeout and break "perpetually on".
CONFIG_ZMK_RGB_UNDERGLOW_AUTO_OFF_IDLE=n
# Must be explicit =n: ZMK's Kconfig.defaults forces this on by default, so
# merely omitting it leaves the rail coupled to RGB on/off (the bug).
CONFIG_ZMK_RGB_UNDERGLOW_EXT_POWER=n

CONFIG_ZMK_RGB_UNDERGLOW_ON_START=y
CONFIG_ZMK_RGB_UNDERGLOW_EFF_START=0
# Identity brightness scaling so ZMK's solid render (toggle ON) and our direct
# fill (toggle OFF, selector held) produce the exact same colour. These are
# also the ZMK defaults; set explicitly so the match can't drift.
CONFIG_ZMK_RGB_UNDERGLOW_BRT_MIN=0
CONFIG_ZMK_RGB_UNDERGLOW_BRT_MAX=100
# Start white (layer 0 colour); the per-layer indicator takes over after boot.
CONFIG_ZMK_RGB_UNDERGLOW_HUE_START=0
CONFIG_ZMK_RGB_UNDERGLOW_SAT_START=0
CONFIG_ZMK_RGB_UNDERGLOW_BRT_START=80
```

## config/west.yml
```yaml
# Copyright (c) 2026 Carl Henriksson
# SPDX-License-Identifier: MIT

manifest:
  remotes:
    - name: zmkfirmware
      url-base: https://github.com/zmkfirmware
  projects:
    - name: zmk
      remote: zmkfirmware
      # ZMK main, pinned 2026-04-24.
      revision: 0331b7d16e80954b807917f9323e59ffc1e3b626
      import: app/west.yml
  self:
    path: config
```

## drivers/sensor/ma730/Kconfig
```kconfig
# Copyright (c) 2026 Carl Henriksson
# SPDX-License-Identifier: MIT

config MA730_INPUT
	bool "MA730 magnetic encoder input driver"
	depends on SPI && INPUT
	help
	  Driver for the MagAlpha MA730 absolute magnetic rotary encoder.
	  Emits relative wheel events via the Zephyr input subsystem.

if MA730_INPUT

choice MA730_INPUT_TRIGGER
	prompt "Trigger mode"
	default MA730_INPUT_TRIGGER_GLOBAL_THREAD

config MA730_INPUT_TRIGGER_GLOBAL_THREAD
	bool "Global system workqueue"
	help
	  Encoder polls run on the system workqueue.
	  Switch to the dedicated thread option if polls are delayed by
	  other work items causing irregular scroll latency.

config MA730_INPUT_TRIGGER_OWN_THREAD
	bool "Dedicated thread"
	help
	  Encoder polls run on a dedicated thread. Use if the global
	  workqueue is causing irregular scroll latency under heavy load.

endchoice

config MA730_INPUT_POLL_INTERVAL_MS
	int "Poll interval (milliseconds)"
	default 8
	range 1 8
	help
	  Encoder sampling interval in milliseconds.
	  Lower values increase polling frequency and SPI traffic.

config MA730_INPUT_THREAD_PRIORITY
	int "Thread priority (cooperative)"
	depends on MA730_INPUT_TRIGGER_OWN_THREAD
	default 10
	help
	  Priority passed to K_PRIO_COOP() for the encoder poll thread.
	  Valid cooperative priorities are 0 through
	  CONFIG_NUM_COOP_PRIORITIES - 1.

config MA730_INPUT_THREAD_STACK_SIZE
	int "Thread stack size"
	depends on MA730_INPUT_TRIGGER_OWN_THREAD
	default 2048
	help
	  Stack size in bytes for the encoder poll thread. Reduce only
	  after measuring with CONFIG_THREAD_ANALYZER.

endif
```

## dts/bindings/sensor/polarityworks,ma730-input.yaml
```yaml
# Copyright (c) 2026 Carl Henriksson
# SPDX-License-Identifier: MIT

description: |
  MagAlpha MA730 absolute magnetic rotary encoder.

  Polls angle over SPI and, depending on the highest active ZMK keymap
  layer, drives one of several "worlds" selected by the per-layer
  `layer-modes` array (see boards/polarityworks/rotr/rotr-ma730.h):
  inactive, keyboard taps (layer-keycodes-cw / -ccw), smooth vertical or
  horizontal scrolling, or the hold-middle layer selector.

  Requires SPI mode 3. spi-max-frequency must not exceed the MA730 limit.

compatible: "polarityworks,ma730-input"

include: spi-device.yaml

properties:
  layer-modes:
    type: array
    required: true
    description: |
      Per-layer knob mode, indexed by ZMK layer index. Use the MA730_MODE_*
      values from rotr-ma730.h. Length must match layer-keycodes-cw/-ccw.

  layer-keycodes-cw:
    type: array
    required: true
    description: |
      Per-layer encoded keycode tapped on clockwise rotation (MA730_MODE_KEY
      layers only; 0 elsewhere). Same length/order as layer-modes.

  layer-keycodes-ccw:
    type: array
    required: true
    description: |
      Per-layer encoded keycode tapped on counter-clockwise rotation
      (MA730_MODE_KEY layers only; 0 elsewhere). Same length as layer-modes.

  select-layer-count:
    type: int
    default: 5
    description: |
      Number of layers the hold-middle selector cycles through, starting at
      0. Default 5 => cycles layers 0-4; reserved layers 5+ are excluded
      until this is raised. THE single value to bump when activating a
      reserved layer.

  select-counts-per-step:
    type: int
    default: 8192
    description: |
      Raw encoder counts per selector advance, independent of scroll
      sensitivity (the selector never uses zip_scroll_scaler). 65536 / 8192
      = ~8 steps per revolution: a coarse, deliberate one-layer-per-nudge
      feel. Larger = coarser.

  reversal-threshold:
    type: int
    default: 10
    description: |
      Minimum raw-count delta to confirm a direction change. Sub-threshold
      opposing deltas are discarded so detent jitter cannot flip direction.

  scroll-counts-per-unit:
    type: int
    default: 64
    description: |
      Raw encoder counts per emitted wheel unit on scroll layers. The MA730
      is 16-bit (65536 counts/rev), so 64 -> ~1024 fine units/rev before the
      input-processor-scaler divides them down. Lower = more sensitive.

  key-counts-per-detent:
    type: int
    default: 2731
    description: |
      Raw encoder counts per key tap on keyboard layers. 65536 / 2731 ~= 24
      detents/rev. Lower = more taps per turn.

  scroll-accel-gain:
    type: int
    default: 6
    description: |
      Velocity-based scroll acceleration. Per-poll speed (raw counts since
      the last ~8 ms poll) times this gain is added to a 256-based unity
      factor. 0 disables acceleration (linear scrolling).

  scroll-accel-max:
    type: int
    default: 1024
    description: |
      Upper clamp on the acceleration factor (256 = 1x, 1024 = up to 4x).

  invert-scroll:
    type: boolean
    description: |
      Invert VERTICAL wheel direction. Default: clockwise scrolls DOWN.

  invert-hscroll:
    type: boolean
    description: |
      Invert HORIZONTAL wheel direction. Default: clockwise pans RIGHT.
```

## src/Kconfig
```kconfig
# Copyright (c) 2026 Carl Henriksson
# SPDX-License-Identifier: MIT

config ROTR_RGB_INDICATOR
	bool "ROTR per-layer RGB underglow indicator"
	depends on ZMK_RGB_UNDERGLOW
	default y
	help
	  Show the active keymap layer's colour on the underglow via a
	  layer-state-changed listener. Toggle on keeps the layer colour lit;
	  toggle off stays dark except while the selector is held.

config ROTR_POWER_POLICY
	bool "ROTR connection-aware power policy"
	depends on ZMK_USB && ZMK_BLE
	select ZMK_PM_DEVICE_SUSPEND_RESUME
	select PM_DEVICE
	select POWEROFF
	default y
	help
	  Prefer USB HID over BLE, then power off after connection-specific
	  inactivity timeouts or immediately after disconnect conditions.

config ROTR_POWER_POLICY_USB_TIMEOUT_MS
	int "ROTR USB inactivity timeout (milliseconds)"
	depends on ROTR_POWER_POLICY
	default 900000
	help
	  Inactivity period before power-off while USB HID is ready.

config ROTR_POWER_POLICY_BLE_TIMEOUT_MS
	int "ROTR BLE/disconnected inactivity timeout (milliseconds)"
	depends on ROTR_POWER_POLICY
	default 300000
	help
	  Inactivity period before power-off while using BLE or while not
	  connected to any host.
```
